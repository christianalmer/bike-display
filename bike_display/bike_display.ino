/*
 * Bay Wheels Bike Availability Display
 * ------------------------------------
 * Elecrow CrowPanel 2.13" e-paper (ESP32-S3) + Bay Wheels GBFS feed
 * Station: <station> Ave (<station-code>)
 *
 * Behavior:
 *   - Polls the public GBFS station_status feed once per minute
 *   - Shows e-bikes available big, classic bikes below
 *   - Fast DU refresh when a displayed count changes
 *   - Full GC refresh every 5 fast refreshes to clear ghosting
 *   - "No data" if fetches keep failing (stale counts are worse than none)
 *
 * Display stack: crowpanel-epd library (SSD1680 driver) + Adafruit GFX
 * drawing into an off-screen 1-bit canvas. If this unit is the newer
 * CrowPanel revision (JD79661 panel), swap the driver in the library —
 * symptom: "refresh done in 0 ms" on serial, no BUSY response.
 *
 * Data: station_status.json is ~240 KB (all 634 stations), far too big to
 * buffer. We force HTTP/1.0 (no chunked encoding), scan the raw stream to
 * the "stations" array, and deserialize one small station object at a time
 * until we hit ours — peak JSON memory is one station, not the feed.
 *
 * Libraries (Library Manager): Adafruit GFX, ArduinoJson (v7)
 *
 * Board settings (per Elecrow tutorial): "ESP32S3 Dev Module",
 * PSRAM: OPI PSRAM, Partition scheme: Huge APP (3MB No OTA/1MB SPIFFS)
 */

#include <WiFi.h>
#include <WiFiClientSecure.h>
#include <HTTPClient.h>
#include <ArduinoJson.h>
#include <Adafruit_GFX.h>
#include <Fonts/FreeSansBold24pt7b.h>
#include <Fonts/FreeSansBold12pt7b.h>
#include <Fonts/FreeSans9pt7b.h>
#include <epd1680.h>     // crowpanel-epd library
#include <epd_canvas.h>  // epdCanvasToPanel()
#include "bike_icon.h"   // generated by preview/bike_icon.py

// ======================= CONFIG =======================
#include "secrets.h"  // gitignored; copy secrets.h.example and fill in
const char* WIFI_SSID = SECRET_WIFI_SSID;
const char* WIFI_PASS = SECRET_WIFI_PASS;

// Public feed, no API key. baywheels.com 301s to gbfs.lyftbikes.com, so
// redirect-following is enabled in the fetch.
const char* TRENDS_POLL_URL =
    "https://baywheels-trends.christian-7ee.workers.dev/api/poll";
const char* GBFS_STATUS_URL =
    "https://gbfs.baywheels.com/gbfs/en/station_status.json";
const char* STATION_ID = "<station-id>";  // <station> Ave
const char* STATION_LABEL = "<station>";

const uint32_t FETCH_INTERVAL_MS  = 60UL * 1000UL;      // feed updates every ~30-60s
const uint32_t STALE_AFTER_MS     = 5UL * 60UL * 1000UL;  // show "No data" past this
const uint8_t  FULL_REFRESH_EVERY = 5;                  // partials between full refreshes

// ======================= DISPLAY =======================
// Draw in landscape 250x122 on a 1-bit canvas; epdCanvasToPanel() (library)
// translates it to the panel's portrait RAM layout.
GFXcanvas1 canvas(250, 122);
uint8_t epdBuf[EPD_BUF_BYTES];

// ======================= STATE =======================
int      bikesAvail  = -1;  // total incl. e-bikes; -1 = no data yet
int      ebikesAvail = 0;
int      docksAvail  = 0;   // fetched for logging, not displayed
uint32_t lastGoodMs  = 0;   // millis() of last successful fetch
bool     haveData    = false;
int      lastShownEbikes = -999, lastShownClassic = -999;
uint8_t  partialsSinceFull = 0;
uint32_t lastFetchMs = 0;

// ======================= GBFS FETCH =======================
// Streams the ~240 KB station_status feed and parses one station object at
// a time (ArduinoJson "deserialize in chunks" pattern). useHTTP10 keeps the
// raw stream free of chunked-encoding framing.
//
// Custom reader for deserializeJson: NetworkClientSecure::read(buf,len)
// returns -1 whenever no decrypted bytes are pending (core 3.3.11,
// NetworkClientSecure.cpp:273), and NetworkClient::readBytes treats r<0 as
// fatal, so ArduinoJson hits a false EOF ("IncompleteInput") at every
// TLS-record boundary. This reader waits for data like Stream::timedRead
// does (which is why find()/findUntil() on the raw stream are unaffected).
struct PatientReader {
  NetworkClient& c;
  explicit PatientReader(NetworkClient& client) : c(client) {}
  int read() {
    uint32_t t0 = millis();
    do {
      int b = c.read();
      if (b >= 0) return b;
      if (!c.connected() && c.available() <= 0) return -1;  // true EOF
      delay(1);
    } while (millis() - t0 < 10000);
    return -1;
  }
  size_t readBytes(char* buf, size_t len) {
    size_t n = 0;
    while (n < len) {
      int b = read();
      if (b < 0) break;
      buf[n++] = (char)b;
    }
    return n;
  }
};

bool fetchStationStatus() {
  WiFiClientSecure client;
  client.setInsecure();  // fine for public bike counts; pin a cert if you like

  HTTPClient http;
  http.useHTTP10(true);
  http.setTimeout(10000);
  http.setFollowRedirects(HTTPC_STRICT_FOLLOW_REDIRECTS);
  if (!http.begin(client, GBFS_STATUS_URL)) return false;
  int code = http.GET();
  if (code != HTTP_CODE_OK) {
    Serial.printf("GBFS HTTP %d\n", code);
    http.end();
    return false;
  }

  NetworkClient& s = http.getStream();
  s.setTimeout(10000);  // for find()/findUntil() (timedRead-based)
  PatientReader reader(s);
  uint32_t t0 = millis();
  int scanned = 0;
  bool found = false;
  if (s.find("\"stations\"") && s.find('[')) {
    do {
      JsonDocument doc;  // one station object, a few hundred bytes
      DeserializationError err = deserializeJson(doc, reader);
      if (err) {
        Serial.printf("GBFS parse after %d stations, %lums: %s\n", scanned,
                      (unsigned long)(millis() - t0), err.c_str());
        break;
      }
      scanned++;
      if (strcmp(doc["station_id"] | "", STATION_ID) == 0) {
        bikesAvail  = doc["num_bikes_available"]  | 0;
        ebikesAvail = doc["num_ebikes_available"] | 0;
        docksAvail  = doc["num_docks_available"]  | 0;
        found = true;
        break;
      }
    } while (s.findUntil(",", "]"));
  }
  http.end();

  if (!found) {
    Serial.printf("GBFS: station not found (%d stations scanned)\n", scanned);
    return false;
  }
  lastGoodMs = millis();
  haveData = true;
  Serial.printf("GBFS: %d bikes (%d e-bikes), %d docks (station %d, %lums)\n",
                bikesAvail, ebikesAvail, docksAvail, scanned,
                (unsigned long)(millis() - t0));
  return true;
}

// Stopgap scheduler for the trends logger: Cloudflare's cron triggers are not
// firing on this account (support ticket pending), so the display kicks the
// worker's poll endpoint each cycle. Harmless once cron works (same-second
// writes just overwrite). Fire-and-forget; never blocks the display update.
void pingTrendsLogger() {
  WiFiClientSecure client;
  client.setInsecure();
  HTTPClient http;
  http.setTimeout(8000);
  if (!http.begin(client, TRENDS_POLL_URL)) return;
  int code = http.POST("");
  Serial.printf("Trends ping: HTTP %d\n", code);
  http.end();
}

// ======================= RENDER =======================
// Landscape 250x122: bike badge left, big e-bike count, classic bikes below.
// Layout constants mirror preview/preview.py draw_layout — keep in sync.
void drawBadge() {
  const int16_t BX = 8, BY = 30, BW_ = 62, BH = 62;
  canvas.fillRoundRect(BX, BY, BW_, BH, 8, 1);
  canvas.drawBitmap(BX + (BW_ - BIKE_ICON_W) / 2, BY + (BH - BIKE_ICON_H) / 2,
                    BIKE_ICON, BIKE_ICON_W, BIKE_ICON_H, 0);
}

void render(int ebikes, int classic, bool fullRefresh) {
  const int16_t BASE = 77;      // shared baseline for the big number
  const int16_t SUB_BASE = 112; // bottom info line baseline
  const int16_t LEFT = 84;      // left edge of the text column

  canvas.fillScreen(0);  // white
  canvas.setTextColor(1);
  drawBadge();

  if (ebikes < 0) {
    canvas.setFont(&FreeSansBold12pt7b);
    canvas.setCursor(LEFT, BASE);
    canvas.print("No data");
  } else if (ebikes == 0) {
    canvas.setFont(&FreeSansBold12pt7b);
    canvas.setCursor(LEFT, BASE);
    canvas.print("No e-bikes");
  } else {
    canvas.setFont(&FreeSansBold24pt7b);
    canvas.setCursor(LEFT, BASE);
    canvas.print(ebikes);
    canvas.setFont(&FreeSansBold12pt7b);
    canvas.setCursor(canvas.getCursorX() + 6, BASE);
    canvas.print(ebikes == 1 ? "e-bike" : "e-bikes");
  }

  canvas.setFont(&FreeSans9pt7b);
  canvas.setCursor(LEFT, SUB_BASE);
  if (ebikes >= 0) {
    canvas.print(classic);
    canvas.print(classic == 1 ? " bike" : " bikes");
  } else {
    canvas.print(STATION_LABEL);
  }

  epdCanvasToPanel(canvas, epdBuf);
  uint32_t t0 = millis();
  EPD1680_Init();  // wakes the panel; RAM (previous frame) survives sleep
  if (fullRefresh) {
    EPD1680_DisplayFull(epdBuf);
    partialsSinceFull = 0;
  } else {
    EPD1680_DisplayPartial(epdBuf);
    partialsSinceFull++;
  }
  EPD1680_Sleep();
  Serial.printf("Render (%s) took %lu ms\n", fullRefresh ? "full" : "partial",
                (unsigned long)(millis() - t0));
}

void updateDisplay(bool forceFull) {
  // Fall back to "No data" when fetches have been failing for a while;
  // a stale count is worse than an honest blank.
  int ebikes = ebikesAvail, classic = bikesAvail - ebikesAvail;
  if (!haveData || (millis() - lastGoodMs) > STALE_AFTER_MS) {
    ebikes = -1;
    classic = 0;
  }

  if (forceFull || ebikes != lastShownEbikes || classic != lastShownClassic) {
    bool full = forceFull || partialsSinceFull >= FULL_REFRESH_EVERY;
    render(ebikes, classic, full);
    lastShownEbikes = ebikes;
    lastShownClassic = classic;
  }
}

// ======================= SETUP / LOOP =======================
void setup() {
  Serial.begin(115200);
  delay(500);

  EPD1680_PowerOn();

  // Boot splash before any network: proves the panel works on its own
  Serial.println("Boot splash render...");
  canvas.fillScreen(0);
  canvas.setTextColor(1);
  drawBadge();
  canvas.setFont(&FreeSans9pt7b);
  canvas.setCursor(84, 77);
  canvas.print("starting up...");
  epdCanvasToPanel(canvas, epdBuf);
  EPD1680_Init();
  EPD1680_DisplayFull(epdBuf);
  EPD1680_Sleep();
  Serial.println("Boot splash done");

  WiFi.mode(WIFI_STA);
  WiFi.begin(WIFI_SSID, WIFI_PASS);
  while (WiFi.status() != WL_CONNECTED) { delay(250); Serial.print("."); }
  Serial.println("\nWiFi connected");

  if (!fetchStationStatus()) Serial.println("Initial fetch FAILED");
  lastFetchMs = millis();
  updateDisplay(true);
  pingTrendsLogger();
}

void loop() {
  if (millis() - lastFetchMs >= FETCH_INTERVAL_MS) {
    if (WiFi.status() != WL_CONNECTED) WiFi.reconnect();
    fetchStationStatus();
    lastFetchMs = millis();
    updateDisplay(false);
    pingTrendsLogger();  // after the display update so the glass never waits
  }
  delay(1000);
}
